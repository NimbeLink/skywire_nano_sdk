## boards/arm/skywire_nano/Kconfig.board
```kconfig
###
 # \file
 #
 # \brief Provides Skywire Nano board configurations
 #
 # (C) NimbeLink Corp. 2020
 #
 # All rights reserved except as explicitly granted in the license agreement
 # between NimbeLink Corp. and the designated licensee.  No other use or
 # disclosure of this software is permitted. Portions of this software may be
 # subject to third party license terms as specified in this software, and such
 # portions are excluded from the preceding copyright notice of NimbeLink Corp.
 ##

if SOC_NRF9160_SICA

config BOARD_SKYWIRE_NANO_APP
    bool "Skywire Nano -- Non-Secure App"
    help
        This will select the latest Skywire Nano board, which is compatible with
        all hardware variants, but only v1.1.x or greater stack firmware.

config BOARD_SKYWIRE_NANO_APP_V1_0_X
    bool "Skywire Nano -- Non-Secure App, version v1.0.x"
    help
        This will select the older Skywire Nano board, which is compatible with
        the v1.0.x stack firmware Application Binary Interface (ABI). This is
        compatible with all Skywire Nano hardware variants.

endif
```

## boards/arm/skywire_nano/Kconfig.defconfig
```kconfig
###
 # \file
 #
 # \brief Provides Skywire Nano board configurations
 #
 # (C) NimbeLink Corp. 2020
 #
 # All rights reserved except as explicitly granted in the license agreement
 # between NimbeLink Corp. and the designated licensee.  No other use or
 # disclosure of this software is permitted. Portions of this software may be
 # subject to third party license terms as specified in this software, and such
 # portions are excluded from the preceding copyright notice of NimbeLink Corp.
 ##

if BOARD_SKYWIRE_NANO_APP || BOARD_SKYWIRE_NANO_APP_V1_0_X

config BOARD
	default "skywire_nano_app" if BOARD_SKYWIRE_NANO_APP
	default "skywire_nano_app_v1_0_x" if BOARD_SKYWIRE_NANO_APP_V1_0_X

config STACK_ABI_VERSION
    string "Stack firmware Application Binary Interface (ABI) version"
    default "1.1.0+0" if BOARD_SKYWIRE_NANO_APP
    default "1.0.0+0" if BOARD_SKYWIRE_NANO_APP_V1_0_X
    help
        The minimum version of stack firmware on the Skywire Nano in order to be
        compatible with the Application Binary Interface (ABI). This can be used
        when signing images to prevent accidentally using new Non-Secure
        firmware on a device with older stack firmware.

        MCUBoot -- the Skywire Nano boot loader -- does not support a maximum
        version for its compatibility checking, however. As such, this cannot be
        used to prevent the opposite condition, where older Non-Secure firmware
        is used on a device with newer stack firmware.

DT_CHOSEN_Z_CODE_PARTITION := zephyr,code-partition

config FLASH_LOAD_SIZE
	default $(dt_chosen_reg_size_hex,$(DT_CHOSEN_Z_CODE_PARTITION))

config FLASH_LOAD_OFFSET
	default $(dt_chosen_reg_addr_hex,$(DT_CHOSEN_Z_CODE_PARTITION))

# The Skywire Nano boot loader expects our header to be a particular size
config ROM_START_OFFSET
    default 0x200

# The Secure stack firmware will manage TrustZone operations, so do not use the
# nRF Connect SDK implementation
config SPM
    default n

# The Secure stack firmware will manage the co-processor communications, so do
# not use our own BSDLIB
config BSD_LIBRARY
    default n

# We will always need to handle floating-point registers while running alongside
# the Secure stack firmware
config FPU
    default y
config FPU_SHARING
    default y

# We will not manage the clock on our own, as that's the Secure stack firmware's
# responsibility
config CLOCK_CONTROL
    default n

# The Secure stack firmware does not allow Non-Secure access to the crypto by
# default
config HW_CC3XX_FORCE_ALT
    default y

endif
```

## boards/arm/skywire_nano/skywire_nano_app_defconfig
```kconfig
###
 # \file
 #
 # \brief Provides Skywire Nano app configurations
 #
 # © NimbeLink Corp. 2020
 #
 # All rights reserved except as explicitly granted in the license agreement
 # between NimbeLink Corp. and the designated licensee.  No other use or
 # disclosure of this software is permitted. Portions of this software may be
 # subject to third party license terms as specified in this software, and such
 # portions are excluded from the preceding copyright notice of NimbeLink Corp.
 ##

CONFIG_ARM=y
CONFIG_SOC_SERIES_NRF91X=y
CONFIG_SOC_NRF9160_SICA=y
CONFIG_BOARD_SKYWIRE_NANO_APP=y

# Enable MPU
CONFIG_ARM_MPU=y

# Enable TrustZone-M
CONFIG_ARM_TRUSTZONE_M=y

# This Board implies building Non-Secure firmware
CONFIG_TRUSTED_EXECUTION_NONSECURE=y
```

## src/nimbelink/sdk/Kconfig
```kconfig
###
 # \file
 #
 # \brief Provides configurations for the Skywire Nano SDK
 #
 # (C) NimbeLink Corp. 2020
 #
 # All rights reserved except as explicitly granted in the license agreement
 # between NimbeLink Corp. and the designated licensee.  No other use or
 # disclosure of this software is permitted. Portions of this software may be
 # subject to third party license terms as specified in this software, and such
 # portions are excluded from the preceding copyright notice of NimbeLink Corp.
 ##

# The version generation is still available even when not using the NimbeLink
# SDK
menu "NimbeLink Version Generation"
rsource "Kconfig.version"
endmenu

menuconfig NIMBELINK_SDK
    bool "NimbeLink SDK"
    default n
    depends on !BSD_LIBRARY
    select ARM_FIRMWARE_USES_SECURE_ENTRY_FUNCS
    help
        Enables building the NimbeLink SDK and its enabled resources.

if NIMBELINK_SDK
menu "Non-Secure Peripheral Access"
rsource "Kconfig.peripheral_access"
endmenu

config AUTO_IMAGE_VALIDATION
    bool "Automatically mark image as valid after application booted"
    default y
    help
        Automatically marks the Non-Secure firmware image as 'valid' once the
        application has fully initialized and booted.

config NIMBELINK_REBOOT
    bool "Handle requesting a reboot using Secure Services"
    default y
    help
        Use Secure Services for system reboot requests.

config ABORT_ON_FATAL_ERROR
    bool "Halt the application when a fatal error occurs"
    depends on !RESET_ON_FATAL_ERROR
    default y
    help
        Allow Secure firmware to halt the application when a fatal error
        occurs. This better allows the Secure firmware to faciliate a
        subsequent DFU operation without risking the Non-Secure application
        firmware causing a hard-to-stop boot loop.

config NIMBELINK_SOCKETS
    bool "Link the Secure Service socket APIs as 'offloaded sockets'"
    default y
    depends on NET_SOCKETS_OFFLOAD
    help
        Automatically link NimbeLink's Secure stack socket Secure Services with
        Zephyr's 'offloaded sockets' subsystem.

config NIMBELINK_AT_CMD
    bool "Redirect the at_cmd APIs to Secure Service APIs"
    default y
    depends on AT_CMD_OFFLOAD
    help
        Redirect APIs for the nRF Connect SDK's at_cmd library to use the
        NimbeLink Secure stack Secure Services.

config NIMBELINK_FOTA_DOWNLOAD
    bool "Redirect the fota_download APIs to Secure Service APIs"
    default y
    depends on FOTA_DOWNLOAD_OFFLOAD
    depends on AT_CMD
    depends on AT_NOTIF
    help
        Redirect APIs for the nRF Connect SDK's fota_download library to use
        the NimbeLink Secure stack Secure Services.

# If we're providing FOTA downloads and the download client isn't selected --
# which is fine, since it's not mandatory for the FOTA download to be offloaded
# -- we'll need to define a buffer size to keep headers/the compiler satisfied
if NIMBELINK_FOTA_DOWNLOAD && !DOWNLOAD_CLIENT
config DOWNLOAD_CLIENT_BUF_SIZE
    int "Stub-in buffer size"
    default 2048

config DOWNLOAD_CLIENT_STACK_SIZE
    int "Stub-in thread stack size"
    default 1024
endif

endif
```

## src/nimbelink/sdk/Kconfig.peripheral_access
```kconfig
###
 # \file
 #
 # \brief Provides peripheral access configurations for the Skywire Nano SDK
 #
 # (C) NimbeLink Corp. 2020
 #
 # All rights reserved except as explicitly granted in the license agreement
 # between NimbeLink Corp. and the designated licensee.  No other use or
 # disclosure of this software is permitted. Portions of this software may be
 # subject to third party license terms as specified in this software, and such
 # portions are excluded from the preceding copyright notice of NimbeLink Corp.
 ##

# For each Nordic peripheral that might get set up during system
# initialization, generate a request to the Secure application to have
# Non-Secure access to the peripheral

config REQUEST_NON_SECURE_UARTE_1
    bool "Request Non-Secure access to UART1"
    default y if UART_1_NRF_UARTE
    default y if SPI_1_NRF_SPI
    default y if I2C_1_NRF_TWIM
    help
        Generates a request for Non-Secure access to the UARTE1 peripheral at
        system startup.

config REQUEST_NON_SECURE_UARTE_2
    bool "Request Non-Secure access to UART2"
    default y if UART_2_NRF_UARTE
    default y if SPI_2_NRF_SPI
    default y if I2C_2_NRF_TWIM
    help
        Generates a request for Non-Secure access to the UARTE2 peripheral at
        system startup.

config REQUEST_NON_SECURE_UARTE_3
    bool "Request Non-Secure access to UART3"
    default y if UART_3_NRF_UARTE
    default y if SPI_3_NRF_SPI
    default y if I2C_3_NRF_TWIM
    help
        Generates a request for Non-Secure access to the UARTE3 peripheral at
        system startup.

config REQUEST_NON_SECURE_SAADC
    bool "Request Non-Secure access to SAADC"
    default n
    help
        Generates a request for Non-Secure access to the SAADC peripheral at
        system startup.

config REQUEST_NON_SECURE_TIMER_0
    bool "Request Non-Secure access to TIMER0"
    default y if NRFX_TIMER0
    help
        Generates a request for Non-Secure access to the TIMER0 peripheral at
        system startup.

config REQUEST_NON_SECURE_TIMER_1
    bool "Request Non-Secure access to TIMER1"
    default y if NRFX_TIMER1
    help
        Generates a request for Non-Secure access to the TIMER1 peripheral at
        system startup.

config REQUEST_NON_SECURE_TIMER_2
    bool "Request Non-Secure access to TIMER2"
    default y if NRFX_TIMER2
    help
        Generates a request for Non-Secure access to the TIMER2 peripheral at
        system startup.

config REQUEST_NON_SECURE_RTC_1
    bool "Request Non-Secure access to RTC1"
    default y if NRF_RTC_TIMER
    help
        Generates a request for Non-Secure access to the RTC1 peripheral at
        system startup.

config REQUEST_NON_SECURE_DPPIC
    bool "Request Non-Secure access to DPPIC"
    default n
    help
        Generates a request for Non-Secure access to the DPPIC peripheral at
        system startup.

config REQUEST_NON_SECURE_EGU_1
    bool "Request Non-Secure access to EGU1"
    default y if NRFX_EGU1
    help
        Generates a request for Non-Secure access to the EGU1 peripheral at
        system startup.

config REQUEST_NON_SECURE_EGU_2
    bool "Request Non-Secure access to EGU2"
    default y if NRFX_EGU2
    help
        Generates a request for Non-Secure access to the EGU2 peripheral at
        system startup.

config REQUEST_NON_SECURE_EGU_3
    bool "Request Non-Secure access to EGU3"
    default y if NRFX_EGU3
    help
        Generates a request for Non-Secure access to the EGU3 peripheral at
        system startup.

config REQUEST_NON_SECURE_EGU_4
    bool "Request Non-Secure access to EGU4"
    default y if NRFX_EGU4
    help
        Generates a request for Non-Secure access to the EGU4 peripheral at
        system startup.

config REQUEST_NON_SECURE_EGU_5
    bool "Request Non-Secure access to EGU5"
    default y if NRFX_EGU5
    help
        Generates a request for Non-Secure access to the EGU5 peripheral at
        system startup.

config REQUEST_NON_SECURE_PWM_0
    bool "Request Non-Secure access to PWM0"
    default y if PWM_0
    help
        Generates a request for Non-Secure access to the PWM0 peripheral at
        system startup.

config REQUEST_NON_SECURE_PWM_1
    bool "Request Non-Secure access to PWM1"
    default y if PWM_1
    help
        Generates a request for Non-Secure access to the PWM1 peripheral at
        system startup.

config REQUEST_NON_SECURE_PWM_2
    bool "Request Non-Secure access to PWM2"
    default y if PWM_2
    help
        Generates a request for Non-Secure access to the PWM2 peripheral at
        system startup.

config REQUEST_NON_SECURE_PWM_3
    bool "Request Non-Secure access to PWM3"
    default y if PWM_3
    help
        Generates a request for Non-Secure access to the PWM3 peripheral at
        system startup.

config REQUEST_NON_SECURE_PDM
    bool "Request Non-Secure access to PDM"
    default n
    help
        Generates a request for Non-Secure access to the PDM peripheral at
        system startup.

config REQUEST_NON_SECURE_I2S
    bool "Request Non-Secure access to I2S"
    default n
    help
        Generates a request for Non-Secure access to the I2S peripheral at
        system startup.
```
