/**
 * © NimbeLink Corp. 2020
 *
 * All rights reserved except as explicitly granted in the license agreement
 * between NimbeLink Corp. and the designated licensee.  No other use or
 * disclosure of this software is permitted. Portions of this software may be
 * subject to third party license terms as specified in this software, and such
 * portions are excluded from the preceding copyright notice of NimbeLink Corp.
 */

/dts-v1/;

#include <nordic/nrf9160ns_sica.dtsi>
#include <nimbelink/nonsecure_partition.dtsi>

/ {
    chosen {
        zephyr,flash = &flash0;
        zephyr,sram = &sram0_widget;
        zephyr,code-partition = &slot0_ns_partition;

        zephyr,console = &uart1;
        zephyr,shell-uart = &uart1;
        zephyr,uart-mcumgr = &uart1;
    };
};
